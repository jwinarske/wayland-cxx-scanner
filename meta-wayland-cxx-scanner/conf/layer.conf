## meta-wayland-cxx-scanner/conf/layer.conf
```bitbake
# SPDX-License-Identifier: MIT
# Layer configuration for meta-wayland-cxx-scanner

BBPATH .= ":${LAYERDIR}"

BBFILES += "${LAYERDIR}/recipes-*/*/*.bb \
            ${LAYERDIR}/recipes-*/*/*.bbappend"

BBFILE_COLLECTIONS += "wayland-cxx-scanner"
BBFILE_PATTERN_wayland-cxx-scanner = "^${LAYERDIR}/"
BBFILE_PRIORITY_wayland-cxx-scanner = "10"

LAYERDEPENDS_wayland-cxx-scanner = "core openembedded-layer"
LAYERVERSION_wayland-cxx-scanner = "1"

# Compatible with Yocto 5.0 (scarthgap) and 5.1 (styhead)
LAYERSERIES_COMPAT_wayland-cxx-scanner = "scarthgap styhead"
```
